## configs/hach_at91sam9g35ek_defconfig
```kconfig
BR2_arm=y
BR2_ARM_FPU_VFPV2=y
BR2_JLEVEL=30
BR2_CCACHE=y
BR2_KERNEL_HEADERS_VERSION=y
BR2_DEFAULT_KERNEL_VERSION="3.18"
BR2_PACKAGE_HOST_LINUX_HEADERS_CUSTOM_3_18=y
BR2_TOOLCHAIN_BUILDROOT_GLIBC=y
BR2_BINUTILS_VERSION_2_25=y
BR2_TOOLCHAIN_BUILDROOT_CXX=y
BR2_PACKAGE_HOST_GDB=y
BR2_PACKAGE_HOST_GDB_TUI=y
BR2_PACKAGE_HOST_GDB_PYTHON=y
BR2_GDB_VERSION_7_8=y
BR2_TARGET_OPTIMIZATION="-pipe"
BR2_ECLIPSE_REGISTER=y
BR2_TARGET_GENERIC_HOSTNAME="chlorine"
BR2_TARGET_GENERIC_ROOT_PASSWD="atlantis7890"
BR2_TARGET_GENERIC_GETTY_PORT="ttyS0"
BR2_TARGET_GENERIC_GETTY_BAUDRATE_115200=y
BR2_TARGET_TZ_INFO=y
BR2_ROOTFS_OVERLAY="/opt/Programs/atlantis/source/rootfs_nand_overlay"
BR2_ROOTFS_POST_BUILD_SCRIPT="$(SCRIPTS_DIR)/setKeyBoard.sh $(SCRIPTS_DIR)/setUpSSH.sh"
BR2_LINUX_KERNEL=y
BR2_LINUX_KERNEL_CUSTOM_GIT=y
BR2_LINUX_KERNEL_CUSTOM_REPO_URL="https://github.com/linux4hach/linux-hach.git"
BR2_LINUX_KERNEL_CUSTOM_REPO_VERSION="v3.15-atmel"
BR2_LINUX_KERNEL_DEFCONFIG="hach-at91sam9g35"
BR2_LINUX_KERNEL_ZIMAGE=y
BR2_LINUX_KERNEL_DTS_SUPPORT=y
BR2_LINUX_KERNEL_INTREE_DTS_NAME="at91sam9g35ek"
BR2_PACKAGE_BUSYBOX_SHOW_OTHERS=y
BR2_PACKAGE_ALSA_UTILS=y
BR2_PACKAGE_ALSA_UTILS_AMIXER=y
BR2_PACKAGE_ALSA_UTILS_APLAY=y
BR2_PACKAGE_ALSA_UTILS_SPEAKER_TEST=y
BR2_PACKAGE_GDB=y
BR2_PACKAGE_GDB_SERVER=y
BR2_PACKAGE_GDB_DEBUGGER=y
BR2_PACKAGE_GDB_TUI=y
BR2_PACKAGE_STRACE=y
BR2_PACKAGE_FLEX=y
BR2_PACKAGE_DOSFSTOOLS=y
BR2_PACKAGE_DOSFSTOOLS_FATLABEL=y
BR2_PACKAGE_DOSFSTOOLS_FSCK_FAT=y
BR2_PACKAGE_DOSFSTOOLS_MKFS_FAT=y
BR2_PACKAGE_FLASHBENCH=y
BR2_PACKAGE_MTD=y
BR2_PACKAGE_MTD_DOCFDISK=y
BR2_PACKAGE_MTD_MKFSUBIFS=y
BR2_PACKAGE_DIRECTFB=y
BR2_PACKAGE_DIRECTFB_EXAMPLES=y
BR2_PACKAGE_DIRECTFB_EXAMPLES_ANDI=y
BR2_PACKAGE_FBV=y
BR2_PACKAGE_QT=y
BR2_PACKAGE_QT_LICENSE_APPROVED=y
BR2_PACKAGE_QT_PIXEL_DEPTH_24=y
BR2_PACKAGE_QT_SYSTEMFREETYPE=y
BR2_PACKAGE_QT_QTPNG=y
BR2_PACKAGE_QT_KEYBOARD_LINUXINPUT=y
BR2_PACKAGE_QWT=y
BR2_PACKAGE_QWT_SVG=y
BR2_PACKAGE_DEJAVU=y
BR2_PACKAGE_LIBERATION=y
BR2_PACKAGE_DEVMEM2=y
BR2_PACKAGE_EVTEST=y
BR2_PACKAGE_GPTFDISK=y
BR2_PACKAGE_GPTFDISK_SGDISK=y
BR2_PACKAGE_GPTFDISK_CGDISK=y
BR2_PACKAGE_I2C_TOOLS=y
BR2_PACKAGE_LM_SENSORS=y
BR2_PACKAGE_PYTHON=y
BR2_PACKAGE_LIBARCHIVE=y
BR2_PACKAGE_LIBGCRYPT=y
BR2_PACKAGE_SQLITE=y
BR2_PACKAGE_LIBFUSE=y
BR2_PACKAGE_LIBLOCKFILE=y
BR2_PACKAGE_LIBART=y
BR2_PACKAGE_TIFF=y
BR2_PACKAGE_WAYLAND=y
BR2_PACKAGE_LIBXKBCOMMON=y
BR2_PACKAGE_MTDEV=y
BR2_PACKAGE_LIBXML2=y
BR2_PACKAGE_YAJL=y
BR2_PACKAGE_LIBCURL=y
BR2_PACKAGE_ICU=y
BR2_PACKAGE_PCRE=y
BR2_PACKAGE_PCRE_16=y
BR2_PACKAGE_BLUEZ_UTILS=y
BR2_PACKAGE_LIGHTTPD=y
BR2_PACKAGE_OPENSSH=y
BR2_PACKAGE_BASH=y
BR2_PACKAGE_VIM=y
BR2_TARGET_ROOTFS_JFFS2=y
BR2_TARGET_ROOTFS_JFFS2_DIR="var"
BR2_TARGET_ROOTFS_JFFS2_CUSTOM=y
BR2_TARGET_ROOTFS_JFFS2_CUSTOM_PAGESIZE=0x100
BR2_TARGET_ROOTFS_JFFS2_CUSTOM_EBSIZE=0x10000
BR2_TARGET_ROOTFS_SQUASHFS=y
BR2_TARGET_ROOTFS_TAR_GZIP=y
BR2_TARGET_ROOTFS_UBIFS=y
BR2_TARGET_ROOTFS_UBIFS_LEBSIZE=0x1f000
BR2_TARGET_ROOTFS_UBI=y
BR2_TARGET_ROOTFS_UBI_SUBSIZE=2048
BR2_TARGET_AT91BOOTSTRAP3=y
BR2_TARGET_AT91BOOTSTRAP3_DEFCONFIG="at91sam9x5eknf_uboot"
BR2_TARGET_UBOOT=y
BR2_TARGET_UBOOT_BOARDNAME="at91sam9x5ek_nandflash"
BR2_TARGET_UBOOT_CUSTOM_GIT=y
BR2_TARGET_UBOOT_CUSTOM_REPO_URL="https://github.com/linux4hach/u-boot-at91.git  "
BR2_TARGET_UBOOT_CUSTOM_REPO_VERSION="a2c326c1967d5329e736d03b1181815cbdca4b55  "
```

## defconfig
```kconfig
BR2_arm=y
BR2_JLEVEL=30
BR2_TOOLCHAIN_EXTERNAL=y
BR2_TOOLCHAIN_EXTERNAL_CUSTOM=y
BR2_TOOLCHAIN_EXTERNAL_PATH="/opt/Programs/buildroot-at91/output/host/usr/bin"
BR2_TARGET_GENERIC_HOSTNAME="chlorine"
BR2_TARGET_GENERIC_ISSUE="Welcome to ChlorineDetect"
BR2_TARGET_GENERIC_ROOT_PASSWD="atlantis7890"
BR2_TARGET_GENERIC_NOBODY_PASSWD="cm130"
BR2_ROOTFS_OVERLAY="/opt/Projects/cm130/sdcard_overlay"
BR2_ROOTFS_POST_BUILD_SCRIPT="$(SCRIPTS_DIR)/setKeyBoard.sh"
BR2_LINUX_KERNEL=y
BR2_LINUX_KERNEL_CUSTOM_GIT=y
BR2_LINUX_KERNEL_CUSTOM_REPO_URL="https://github.com/linux4hach/linux-hach.git"
BR2_LINUX_KERNEL_CUSTOM_REPO_VERSION="v3.15-atmel"
BR2_LINUX_KERNEL_DEFCONFIG="hach-at91sam9g35"
BR2_LINUX_KERNEL_ZIMAGE=y
BR2_LINUX_KERNEL_DTS_SUPPORT=y
BR2_LINUX_KERNEL_INTREE_DTS_NAME="at91sam9g35ek"
BR2_PACKAGE_BUSYBOX_SHOW_OTHERS=y
BR2_PACKAGE_FLEX=y
BR2_PACKAGE_MTD=y
BR2_PACKAGE_MTD_DOCFDISK=y
BR2_PACKAGE_FBDUMP=y
BR2_PACKAGE_FBGRAB=y
BR2_PACKAGE_FBSET=y
BR2_PACKAGE_DBUS=y
BR2_PACKAGE_DEVMEM2=y
BR2_PACKAGE_EVTEST=y
BR2_PACKAGE_EVTEST_CAPTURE=y
BR2_PACKAGE_I2C_TOOLS=y
BR2_PACKAGE_LM_SENSORS=y
BR2_PACKAGE_ALSA_LIB=y
BR2_PACKAGE_LZO=y
BR2_PACKAGE_LIBGCRYPT=y
BR2_PACKAGE_OPENSSL=y
BR2_PACKAGE_FONTCONFIG=y
BR2_PACKAGE_LIBART=y
BR2_PACKAGE_LIBUNGIF=y
BR2_PACKAGE_PIXMAN=y
BR2_PACKAGE_TIFF=y
BR2_PACKAGE_LIBUSB=y
BR2_PACKAGE_LIBUSB_COMPAT=y
BR2_PACKAGE_LIBXKBCOMMON=y
BR2_PACKAGE_MTDEV=y
BR2_PACKAGE_TSLIB=y
BR2_PACKAGE_YAJL=y
BR2_PACKAGE_LIBCURL=y
BR2_PACKAGE_LIBESMTP=y
BR2_PACKAGE_LIBFCGI=y
BR2_PACKAGE_LIBPCAP=y
BR2_PACKAGE_NEON_EXPAT=y
BR2_PACKAGE_APR_UTIL=y
BR2_PACKAGE_LIBCAP=y
BR2_PACKAGE_LIBFFI=y
BR2_PACKAGE_LIBLOG4C_LOCALTIME=y
BR2_PACKAGE_NCURSES_TARGET_PANEL=y
BR2_PACKAGE_NCURSES_TARGET_FORM=y
BR2_PACKAGE_NCURSES_TARGET_MENU=y
BR2_PACKAGE_POPT=y
BR2_PACKAGE_READLINE=y
BR2_PACKAGE_ARPTABLES=y
BR2_PACKAGE_IPTABLES=y
BR2_PACKAGE_NETSNMP=y
BR2_PACKAGE_FILE=y
BR2_PACKAGE_LOCKFILE_PROGS=y
BR2_PACKAGE_KMOD=y
BR2_TARGET_ROOTFS_SQUASHFS=y
BR2_TARGET_ROOTFS_TAR_DIR="usr/share/hach usr/share/jail var"
BR2_TARGET_ROOTFS_TAR_GZIP=y
BR2_TARGET_AT91BOOTSTRAP3=y
BR2_TARGET_AT91BOOTSTRAP3_DEFCONFIG="at91sam9x5eksd_uboot"
BR2_TARGET_UBOOT=y
BR2_TARGET_UBOOT_BOARDNAME="at91sam9x5ek_mmc"
BR2_TARGET_UBOOT_CUSTOM_GIT=y
BR2_TARGET_UBOOT_CUSTOM_REPO_URL="https://github.com/linux4hach/u-boot-at91.git"
BR2_TARGET_UBOOT_CUSTOM_REPO_VERSION="u-boot-2014.07-at91"
BR2_TARGET_UBOOT_FORMAT_CUSTOM=y
BR2_TARGET_UBOOT_FORMAT_CUSTOM_NAME="u-boot.bin"
BR2_TARGET_UBOOT_NETWORK=y
BR2_TARGET_UBOOT_SERVERIP="192.168.1.1"
BR2_TARGET_UBOOT_IPADDR="192.168.1.2"
BR2_TARGET_UBOOT_GATEWAY="192.168.1.0"
BR2_TARGET_UBOOT_ETHADDR="00:0e:1c:11:22:33"
BR2_PACKAGE_HOST_E2FSPROGS=y
BR2_PACKAGE_HOST_GENEXT2FS=y
BR2_PACKAGE_HOST_SAM_BA=y
```
