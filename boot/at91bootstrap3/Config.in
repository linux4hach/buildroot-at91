## boot/at91bootstrap3/Config.in
```kconfig
config BR2_TARGET_AT91BOOTSTRAP3
	depends on BR2_arm926t
	bool "AT91 Bootstrap 3"
	help
	  AT91Bootstrap is a first level bootloader for the Atmel AT91
	  devices. It integrates algorithms for:
	  - Device initialization such as clock configuration, PIO settings...
	  - Peripheral drivers such as PIO, PMC or SDRAMC...
	  - Physical media algorithm such as DataFlash, NandFlash, NOR Flash...

if BR2_TARGET_AT91BOOTSTRAP3

config BR2_TARGET_AT91BOOTSTRAP3_CUSTOM_PATCH_DIR
	string "custom patch dir"
	help
	  If your board requires custom patches, add the path to the
	  directory containing the patches here. The patches must be
	  named at91bootstrap3-<something>.patch.

	  Most users may leave this empty

#
# Configuration selection
#

choice
	prompt "AT91 Bootstrap 3 configuration"
	default BR2_TARGET_AT91BOOTSTRAP3_USE_DEFCONFIG

config BR2_TARGET_AT91BOOTSTRAP3_USE_DEFCONFIG
	bool "Using a defconfig"

config BR2_TARGET_AT91BOOTSTRAP3_USE_VERSION
  bool "Using a version"

config BR2_TARGET_AT91BOOTSTRAP3_USE_CUSTOM_CONFIG
	bool "Using a custom config file"

endchoice


config BR2_TARGET_AT91BOOTSTRAP3_DEFCONFIG
	string "AT91Sam9x5ek Defconfig Name"
	default "at91sam9x5eknf_uboot"	
	depends on BR2_TARGET_AT91BOOTSTRAP3_USE_DEFCONFIG

config BR2_TARGET_AT91BOOTSTRAP3_VERSION
  string "bootstrap version"
  default "test"
	help
	  Name of the at91bootstrap3 version to use, this can be a
	  tag, checksum, or branch name.



config BR2_TARGET_AT91BOOTSTRAP3_CUSTOM_CONFIG_FILE
	string "Configuration file path"
	depends on BR2_TARGET_AT91BOOTSTRAP3_USE_CUSTOM_CONFIG
	help
	  Path to the at91bootstrap3 configuration file

endif # BR2_TARGET_AT91BOOTSTRAP3
```

## configs/at91sam9g35ek_defconfig
```kconfig
BR2_arm=y
BR2_JLEVEL=13
BR2_CCACHE=y
BR2_KERNEL_HEADERS_VERSION=y
BR2_DEFAULT_KERNEL_VERSION="3.15"
BR2_TOOLCHAIN_BUILDROOT_GLIBC=y
BR2_BINUTILS_VERSION_2_23_2=y
BR2_GCC_VERSION_4_8_X=y
BR2_TOOLCHAIN_BUILDROOT_CXX=y
BR2_PACKAGE_HOST_GDB=y
BR2_GDB_VERSION_7_7=y
BR2_ECLIPSE_REGISTER=y
BR2_TARGET_GENERIC_HOSTNAME="chlorine"
BR2_TARGET_GENERIC_ISSUE="Welcome to ChlorineDetect"
BR2_TARGET_GENERIC_ROOT_PASSWD="atlantis7890"
BR2_ROOTFS_POST_BUILD_SCRIPT="$(SCRIPTS_DIR)/setNetwork.sh $(SCRIPTS_DIR)/setKeyBoard.sh $(SCRIPTS_DIR)/setupSFTP.sh"
BR2_LINUX_KERNEL=y
BR2_LINUX_KERNEL_CUSTOM_GIT=y
BR2_LINUX_KERNEL_CUSTOM_REPO_URL="https://github.com/linux4hach/linux-at91.git"
BR2_LINUX_KERNEL_CUSTOM_REPO_VERSION="v3.15-atmel"
BR2_LINUX_KERNEL_DEFCONFIG="at91sam9x5_drm"
BR2_LINUX_KERNEL_ZIMAGE=y
BR2_LINUX_KERNEL_DTS_SUPPORT=y
BR2_LINUX_KERNEL_INTREE_DTS_NAME="at91sam9g35ek"
BR2_PACKAGE_BUSYBOX_SHOW_OTHERS=y
BR2_PACKAGE_BUSYBOX_WATCHDOG=y
BR2_PACKAGE_BUSYBOX_WATCHDOG_PERIOD="10"
BR2_PACKAGE_ALSA_UTILS=y
BR2_PACKAGE_ALSA_UTILS_AMIXER=y
BR2_PACKAGE_ALSA_UTILS_APLAY=y
BR2_PACKAGE_MPD=y
BR2_PACKAGE_GDB=y
BR2_PACKAGE_GDB_SERVER=y
BR2_PACKAGE_GDB_DEBUGGER=y
BR2_PACKAGE_FLEX=y
BR2_PACKAGE_DOSFSTOOLS=y
BR2_PACKAGE_DOSFSTOOLS_FATLABEL=y
BR2_PACKAGE_DOSFSTOOLS_FSCK_FAT=y
BR2_PACKAGE_DOSFSTOOLS_MKFS_FAT=y
BR2_PACKAGE_EXFAT=y
BR2_PACKAGE_EXFAT_UTILS=y
BR2_PACKAGE_F2FS_TOOLS=y
BR2_PACKAGE_GENEXT2FS=y
BR2_PACKAGE_GENROMFS=y
BR2_PACKAGE_MAKEDEVS=y
BR2_PACKAGE_MTD=y
BR2_PACKAGE_NFS_UTILS=y
BR2_PACKAGE_UNIONFS=y
BR2_PACKAGE_FBV=y
BR2_PACKAGE_FB_TEST_APP=y
BR2_PACKAGE_QT=y
BR2_PACKAGE_QT_LICENSE_APPROVED=y
# BR2_PACKAGE_QT_PIXEL_DEPTH_8 is not set
# BR2_PACKAGE_QT_PIXEL_DEPTH_16 is not set
BR2_PACKAGE_QT_PIXEL_DEPTH_24=y
# BR2_PACKAGE_QT_PIXEL_DEPTH_32 is not set
BR2_PACKAGE_QT_GIF=y
BR2_PACKAGE_QT_LIBMNG=y
BR2_PACKAGE_QT_QTJPEG=y
BR2_PACKAGE_QT_QTPNG=y
BR2_PACKAGE_QT_QTTIFF=y
BR2_PACKAGE_QT_KEYBOARD_TTY=y
BR2_PACKAGE_QT_KEYBOARD_LINUXINPUT=y
BR2_PACKAGE_QT_KEYBOARD_QVFB=y
# BR2_PACKAGE_QT_XML is not set
BR2_PACKAGE_QT_WEBKIT=y
BR2_PACKAGE_DBUS=y
BR2_PACKAGE_EVTEST=y
BR2_PACKAGE_GPTFDISK=y
BR2_PACKAGE_GPTFDISK_GDISK=y
BR2_PACKAGE_GPTFDISK_SGDISK=y
BR2_PACKAGE_GPTFDISK_CGDISK=y
BR2_PACKAGE_I2C_TOOLS=y
BR2_PACKAGE_PYTHON=y
BR2_PACKAGE_CAIRO=y
BR2_PACKAGE_CAIRO_PNG=y
BR2_PACKAGE_WAYLAND=y
BR2_PACKAGE_LIBUSB=y
BR2_PACKAGE_LIBUSB_COMPAT=y
BR2_PACKAGE_LIBXKBCOMMON=y
BR2_PACKAGE_MTDEV=y
BR2_PACKAGE_TSLIB=y
BR2_PACKAGE_LIBFCGI=y
BR2_PACKAGE_NEON_EXPAT=y
BR2_PACKAGE_APR_UTIL=y
BR2_PACKAGE_LIBCAP=y
BR2_PACKAGE_COLLECTD=y
BR2_PACKAGE_ARPTABLES=y
BR2_PACKAGE_ETHTOOL=y
BR2_PACKAGE_LIGHTTPD=y
BR2_PACKAGE_LIGHTTPD_OPENSSL=y
BR2_PACKAGE_NTP=y
BR2_PACKAGE_OPENSSH=y
BR2_PACKAGE_SAMBA=y
BR2_PACKAGE_SPAWN_FCGI=y
BR2_PACKAGE_VSFTPD=y
BR2_PACKAGE_OPKG=y
BR2_PACKAGE_OPKG_GPG_SIGN=y
BR2_PACKAGE_BASH=y
BR2_PACKAGE_LOCKFILE_PROGS=y
BR2_PACKAGE_KMOD=y
BR2_PACKAGE_UTIL_LINUX_BINARIES=y
BR2_PACKAGE_UTIL_LINUX_MOUNT=y
BR2_PACKAGE_VIM=y
BR2_TARGET_ROOTFS_EXT2=y
BR2_TARGET_ROOTFS_TAR_GZIP=y
BR2_TARGET_ROOTFS_UBIFS=y
BR2_TARGET_ROOTFS_UBIFS_LEBSIZE=0x1f000
BR2_TARGET_ROOTFS_UBI=y
BR2_TARGET_ROOTFS_UBI_SUBSIZE=2048
BR2_TARGET_AT91BOOTSTRAP3=y
BR2_TARGET_AT91BOOTSTRAP3_DEFCONFIG="at91sam9x5eknf_uboot"
BR2_TARGET_UBOOT=y
BR2_TARGET_UBOOT_BOARDNAME="at91sam9x5ek_nandflash"
BR2_PACKAGE_HOST_SAM_BA=y
```

## configs/at91sam9x5ek_defconfig
```kconfig
BR2_arm=y
BR2_JLEVEL=13
BR2_TOOLCHAIN_BUILDROOT_MUSL=y
BR2_BINUTILS_VERSION_2_27_X=y
BR2_GCC_VERSION_6_X=y
BR2_TOOLCHAIN_BUILDROOT_CXX=y
BR2_GCC_ENABLE_LTO=y
BR2_ECLIPSE_REGISTER=y
BR2_LINUX_KERNEL=y
BR2_LINUX_KERNEL_CUSTOM_GIT=y
BR2_LINUX_KERNEL_CUSTOM_REPO_URL="https://github.com/linux4hach/linux-at91.git"
BR2_LINUX_KERNEL_CUSTOM_REPO_VERSION="4.8-at91"
BR2_LINUX_KERNEL_DEFCONFIG="at91_dt"
BR2_LINUX_KERNEL_DTS_SUPPORT=y
BR2_LINUX_KERNEL_INTREE_DTS_NAME="at91sam9g35ek"
BR2_TARGET_ROOTFS_UBIFS=y
BR2_TARGET_ROOTFS_UBIFS_LEBSIZE=0x1f000
BR2_TARGET_ROOTFS_UBI=y
BR2_TARGET_ROOTFS_UBI_SUBSIZE=2048
BR2_TARGET_AT91BOOTSTRAP3=y
BR2_TARGET_AT91BOOTSTRAP3_CUSTOM_GIT=y
BR2_TARGET_AT91BOOTSTRAP3_CUSTOM_REPO_URL="https://github.com/linux4hach/at91bootstrap.git"
BR2_TARGET_AT91BOOTSTRAP3_CUSTOM_REPO_VERSION="v3.8.7"
BR2_TARGET_AT91BOOTSTRAP3_DEFCONFIG="at91sam9x5eknf_uboot"
BR2_TARGET_UBOOT=y
BR2_TARGET_UBOOT_BUILD_SYSTEM_KCONFIG=y
BR2_TARGET_UBOOT_CUSTOM_GIT=y
BR2_TARGET_UBOOT_CUSTOM_REPO_URL="https://github.com/linux4hach/u-boot-at91.git"
BR2_TARGET_UBOOT_CUSTOM_REPO_VERSION="u-boot-2014.07-at91"
BR2_TARGET_UBOOT_BOARD_DEFCONFIG="at91sam9x5ek_nandflash"
BR2_PACKAGE_HOST_SAM_BA=y
```

## configs/hach-at91sam9g35_defconfig
```kconfig
BR2_arm=y
BR2_JLEVEL=13
BR2_CCACHE=y
BR2_KERNEL_HEADERS_VERSION=y
BR2_DEFAULT_KERNEL_VERSION="3.15"
BR2_TOOLCHAIN_BUILDROOT_GLIBC=y
BR2_BINUTILS_VERSION_2_23_2=y
BR2_GCC_VERSION_4_8_X=y
BR2_TOOLCHAIN_BUILDROOT_CXX=y
BR2_PACKAGE_HOST_GDB=y
BR2_GDB_VERSION_7_7=y
BR2_ECLIPSE_REGISTER=y
BR2_TARGET_GENERIC_HOSTNAME="chlorine"
BR2_TARGET_GENERIC_ISSUE="Welcome to ChlorineDetect"
BR2_TARGET_GENERIC_ROOT_PASSWD="atlantis7890"
BR2_ROOTFS_POST_BUILD_SCRIPT="$(SCRIPTS_DIR)/setNetwork.sh $(SCRIPTS_DIR)/setKeyBoard.sh $(SCRIPTS_DIR)/setupSFTP.sh"
BR2_LINUX_KERNEL=y
BR2_LINUX_KERNEL_CUSTOM_GIT=y
BR2_LINUX_KERNEL_CUSTOM_REPO_URL="https://github.com/linux4hach/linux-at91.git"
BR2_LINUX_KERNEL_CUSTOM_REPO_VERSION="v3.15-atmel"
BR2_LINUX_KERNEL_DEFCONFIG="hach-at91sam9g35"
BR2_LINUX_KERNEL_ZIMAGE=y
BR2_LINUX_KERNEL_DTS_SUPPORT=y
BR2_LINUX_KERNEL_INTREE_DTS_NAME="at91sam9g35ek"
BR2_PACKAGE_BUSYBOX_SHOW_OTHERS=y
BR2_PACKAGE_BUSYBOX_WATCHDOG=y
BR2_PACKAGE_ALSA_UTILS=y
BR2_PACKAGE_ALSA_UTILS_AMIXER=y
BR2_PACKAGE_ALSA_UTILS_APLAY=y
BR2_PACKAGE_ALSA_UTILS_SPEAKER_TEST=y
BR2_PACKAGE_MPLAYER=y
BR2_PACKAGE_GDB=y
BR2_PACKAGE_GDB_SERVER=y
BR2_PACKAGE_GDB_DEBUGGER=y
BR2_PACKAGE_STRACE=y
BR2_PACKAGE_FLEX=y
BR2_PACKAGE_FLASHBENCH=y
BR2_PACKAGE_MTD=y
BR2_PACKAGE_GNUPLOT=y
BR2_PACKAGE_FBDUMP=y
BR2_PACKAGE_FBGRAB=y
BR2_PACKAGE_FBSET=y
BR2_PACKAGE_FBV=y
BR2_PACKAGE_FB_TEST_APP=y
BR2_PACKAGE_QT=y
BR2_PACKAGE_QT_LICENSE_APPROVED=y
BR2_PACKAGE_QT_PIXEL_DEPTH_24=y
BR2_PACKAGE_QT_GIF=y
BR2_PACKAGE_QT_LIBMNG=y
BR2_PACKAGE_QT_SYSTEMJPEG=y
BR2_PACKAGE_QT_SYSTEMPNG=y
BR2_PACKAGE_QT_SYSTEMTIFF=y
BR2_PACKAGE_QT_KEYBOARD_LINUXINPUT=y
BR2_PACKAGE_QT_WEBKIT=y
BR2_PACKAGE_DBUS=y
BR2_PACKAGE_DEVMEM2=y
BR2_PACKAGE_EVTEST=y
BR2_PACKAGE_EVTEST_CAPTURE=y
BR2_PACKAGE_I2C_TOOLS=y
BR2_PACKAGE_PYTHON=y
BR2_PACKAGE_CAIRO=y
BR2_PACKAGE_CAIRO_PNG=y
BR2_PACKAGE_WAYLAND=y
BR2_PACKAGE_LIBUSB=y
BR2_PACKAGE_LIBUSB_COMPAT=y
BR2_PACKAGE_LIBXKBCOMMON=y
BR2_PACKAGE_MTDEV=y
BR2_PACKAGE_TSLIB=y
BR2_PACKAGE_LIBFCGI=y
BR2_PACKAGE_NEON_EXPAT=y
BR2_PACKAGE_APR_UTIL=y
BR2_PACKAGE_LIBCAP=y
BR2_PACKAGE_POPT=y
BR2_PACKAGE_COLLECTD=y
BR2_PACKAGE_COLLECTD_EMPTY_COUNTER=y
BR2_PACKAGE_COLLECTD_HASHED=y
BR2_PACKAGE_COLLECTD_REGEX=y
BR2_PACKAGE_COLLECTD_TIMEDIFF=y
BR2_PACKAGE_COLLECTD_VALUE=y
BR2_PACKAGE_COLLECTD_AGGREGATION=y
BR2_PACKAGE_COLLECTD_NOTIFY_EMAIL=y
BR2_PACKAGE_THRESHOLD=y
BR2_PACKAGE_COLLECTD_APACHE=y
BR2_PACKAGE_COLLECTD_APCUPS=y
BR2_PACKAGE_COLLECTD_BATTERY=y
BR2_PACKAGE_COLLECTD_BIND=y
BR2_PACKAGE_COLLECTD_CGROUPS=y
BR2_PACKAGE_COLLECTD_CONNTRACK=y
BR2_PACKAGE_COLLECTD_CONTEXTSWITCH=y
BR2_PACKAGE_COLLECTD_CPU=y
BR2_PACKAGE_COLLECTD_CPUFREQ=y
BR2_PACKAGE_COLLECTD_CURL=y
BR2_PACKAGE_COLLECTD_CURL_JSON=y
BR2_PACKAGE_COLLECTD_CURL_XML=y
BR2_PACKAGE_COLLECTD_DF=y
BR2_PACKAGE_COLLECTD_DISK=y
BR2_PACKAGE_COLLECTD_DNS=y
BR2_PACKAGE_COLLECTD_ENTROPY=y
BR2_PACKAGE_COLLECTD_ETHSTAT=y
BR2_PACKAGE_COLLECTD_EXEC=y
BR2_PACKAGE_COLLECTD_FILECOUNT=y
BR2_PACKAGE_COLLECTD_FSCACHE=y
BR2_PACKAGE_COLLECTD_INTERFACE=y
BR2_PACKAGE_COLLECTD_IPTABLES=y
BR2_PACKAGE_COLLECTD_IRQ=y
BR2_PACKAGE_COLLECTD_LOAD=y
BR2_PACKAGE_COLLECTD_MD=y
BR2_PACKAGE_COLLECTD_MEMCACHED=y
BR2_PACKAGE_COLLECTD_MEMORY=y
BR2_PACKAGE_COLLECTD_MYSQL=y
BR2_PACKAGE_COLLECTD_NFS=y
BR2_PACKAGE_COLLECTD_NTPD=y
BR2_PACKAGE_COLLECTD_OLSRD=y
BR2_PACKAGE_COLLECTD_OPENVPN=y
BR2_PACKAGE_COLLECTD_PING=y
BR2_PACKAGE_COLLECTD_PROCESSES=y
BR2_PACKAGE_COLLECTD_PROTOCOLS=y
BR2_PACKAGE_COLLECTD_SENSORS=y
BR2_PACKAGE_COLLECTD_SERIAL=y
BR2_PACKAGE_COLLECTD_STATSD=y
BR2_PACKAGE_COLLECTD_SNMP=y
BR2_PACKAGE_COLLECTD_SWAP=y
BR2_PACKAGE_COLLECTD_TABLE=y
BR2_PACKAGE_COLLECTD_TAIL=y
BR2_PACKAGE_COLLECTD_TAIL_CSV=y
BR2_PACKAGE_COLLECTD_TCPCONNS=y
BR2_PACKAGE_COLLECTD_THERMAL=y
BR2_PACKAGE_COLLECTD_UPTIME=y
BR2_PACKAGE_COLLECTD_USERS=y
BR2_PACKAGE_COLLECTD_VMEM=y
BR2_PACKAGE_COLLECTD_WIRELESS=y
BR2_PACKAGE_COLLECTD_NOTIFICATION=y
BR2_PACKAGE_COLLECTD_REPLACE=y
BR2_PACKAGE_COLLECTD_SCALE=y
BR2_PACKAGE_COLLECTD_SET=y
BR2_PACKAGE_COLLECTD_CSV=y
BR2_PACKAGE_COLLECTD_GRAPHITE=y
BR2_PACKAGE_COLLECTD_NETWORK=y
BR2_PACKAGE_COLLECTD_RRDTOOL=y
BR2_PACKAGE_COLLECTD_RIEMANN=y
BR2_PACKAGE_COLLECTD_UNIXSOCK=y
BR2_PACKAGE_COLLECTD_WRITEHTTP=y
BR2_PACKAGE_ARPTABLES=y
BR2_PACKAGE_ETHTOOL=y
BR2_PACKAGE_LIGHTTPD=y
BR2_PACKAGE_LIGHTTPD_OPENSSL=y
BR2_PACKAGE_NTP=y
BR2_PACKAGE_OPENSSH=y
BR2_PACKAGE_SPAWN_FCGI=y
BR2_PACKAGE_VSFTPD=y
BR2_PACKAGE_BASH=y
BR2_PACKAGE_FILE=y
BR2_PACKAGE_LOCKFILE_PROGS=y
BR2_PACKAGE_KMOD=y
BR2_PACKAGE_NANO=y
BR2_PACKAGE_VIM=y
BR2_TARGET_ROOTFS_EXT2=y
BR2_TARGET_ROOTFS_TAR_GZIP=y
BR2_TARGET_ROOTFS_UBIFS=y
BR2_TARGET_ROOTFS_UBIFS_LEBSIZE=0x1f000
BR2_TARGET_ROOTFS_UBI=y
BR2_TARGET_ROOTFS_UBI_SUBSIZE=2048
BR2_TARGET_AT91BOOTSTRAP3=y
BR2_TARGET_AT91BOOTSTRAP3_DEFCONFIG="at91sam9x5eknf_uboot"
BR2_TARGET_UBOOT=y
BR2_TARGET_UBOOT_BOARDNAME="at91sam9x5ek_nandflash"
BR2_TARGET_UBOOT_NETWORK=y
BR2_TARGET_UBOOT_SERVERIP="192.168.1.1"
BR2_TARGET_UBOOT_IPADDR="192.168.1.2"
BR2_TARGET_UBOOT_GATEWAY="192.168.1.0"
BR2_TARGET_UBOOT_ETHADDR="00:0e:1c:11:22:33"
BR2_PACKAGE_HOST_SAM_BA=y
```

## configs/hach-at91sam9g35_nor_defconfig
```kconfig
BR2_arm=y
BR2_JLEVEL=20
BR2_KERNEL_HEADERS_VERSION=y
BR2_DEFAULT_KERNEL_VERSION="4.4"
BR2_PACKAGE_HOST_LINUX_HEADERS_CUSTOM_4_4=y
BR2_TOOLCHAIN_BUILDROOT_GLIBC=y
BR2_BINUTILS_VERSION_2_26_X=y
BR2_TOOLCHAIN_BUILDROOT_CXX=y
BR2_PACKAGE_HOST_GDB=y
BR2_GDB_VERSION_7_11=y
BR2_ECLIPSE_REGISTER=y
BR2_TARGET_GENERIC_HOSTNAME="chlorine"
BR2_TARGET_GENERIC_ISSUE="Welcome to ChlorineDetect"
BR2_ROOTFS_OVERLAY="/opt/Projects/cm130/rootfs_overlay"
BR2_ROOTFS_POST_BUILD_SCRIPT="$(SCRIPTS_DIR)/setNetwork.sh $(SCRIPTS_DIR)/setKeyBoard.sh $(SCRIPTS_DIR)/setFilePermissions.sh $(SCRIPTS_DIR)/post-update-shadow-file.sh"
BR2_ROOTFS_POST_IMAGE_SCRIPT="$(SCRIPTS_DIR)/post-op-remove-shadow-symlink.sh"
BR2_LINUX_KERNEL=y
BR2_LINUX_KERNEL_CUSTOM_GIT=y
BR2_LINUX_KERNEL_CUSTOM_REPO_URL="https://github.com/linux4hach/linux-at91.git"
BR2_LINUX_KERNEL_CUSTOM_REPO_VERSION="linux-4.4-at91"
BR2_LINUX_KERNEL_DEFCONFIG="hach-at91sam9g35"
BR2_LINUX_KERNEL_DTS_SUPPORT=y
BR2_LINUX_KERNEL_INTREE_DTS_NAME="at91sam9g35ek"
BR2_PACKAGE_BUSYBOX_SHOW_OTHERS=y
BR2_PACKAGE_ALSA_UTILS=y
BR2_PACKAGE_ALSA_UTILS_AMIXER=y
BR2_PACKAGE_ALSA_UTILS_APLAY=y
BR2_PACKAGE_ALSA_UTILS_SPEAKER_TEST=y
BR2_PACKAGE_MPLAYER=y
BR2_PACKAGE_GDB=y
BR2_PACKAGE_GDB_SERVER=y
BR2_PACKAGE_GDB_DEBUGGER=y
BR2_PACKAGE_STRACE=y
BR2_PACKAGE_FLEX=y
BR2_PACKAGE_E2FSPROGS=y
# BR2_PACKAGE_E2FSPROGS_BADBLOCKS is not set
# BR2_PACKAGE_E2FSPROGS_CHATTR is not set
# BR2_PACKAGE_E2FSPROGS_DUMPE2FS is not set
# BR2_PACKAGE_E2FSPROGS_E2FREEFRAG is not set
# BR2_PACKAGE_E2FSPROGS_E2UNDO is not set
# BR2_PACKAGE_E2FSPROGS_FILEFRAG is not set
# BR2_PACKAGE_E2FSPROGS_FSCK is not set
# BR2_PACKAGE_E2FSPROGS_LOGSAVE is not set
# BR2_PACKAGE_E2FSPROGS_LSATTR is not set
# BR2_PACKAGE_E2FSPROGS_MKE2FS is not set
# BR2_PACKAGE_E2FSPROGS_MKLOSTFOUND is not set
# BR2_PACKAGE_E2FSPROGS_UUIDGEN is not set
BR2_PACKAGE_FLASHBENCH=y
BR2_PACKAGE_MTD=y
BR2_PACKAGE_MTD_DOCFDISK=y
BR2_PACKAGE_FBDUMP=y
BR2_PACKAGE_FBGRAB=y
BR2_PACKAGE_FBSET=y
BR2_PACKAGE_FBV=y
BR2_PACKAGE_QT=y
BR2_PACKAGE_QT_LICENSE_APPROVED=y
BR2_PACKAGE_QT_PIXEL_DEPTH_24=y
BR2_PACKAGE_QT_FONT_UNIFONT=y
BR2_PACKAGE_QT_QTFREETYPE=y
BR2_PACKAGE_QT_GIF=y
BR2_PACKAGE_QT_LIBMNG=y
BR2_PACKAGE_QT_QTJPEG=y
BR2_PACKAGE_QT_QTPNG=y
BR2_PACKAGE_QT_QTTIFF=y
BR2_PACKAGE_QT_KEYBOARD_LINUXINPUT=y
BR2_PACKAGE_QT_SVG=y
BR2_PACKAGE_QT_STL=y
# BR2_PACKAGE_QT_SCRIPT is not set
BR2_PACKAGE_DBUS=y
BR2_PACKAGE_DEVMEM2=y
BR2_PACKAGE_EVTEST=y
BR2_PACKAGE_GPTFDISK=y
BR2_PACKAGE_GPTFDISK_GDISK=y
BR2_PACKAGE_GPTFDISK_SGDISK=y
BR2_PACKAGE_GPTFDISK_CGDISK=y
BR2_PACKAGE_I2C_TOOLS=y
BR2_PACKAGE_LM_SENSORS=y
BR2_PACKAGE_PERL=y
BR2_PACKAGE_PYTHON=y
BR2_PACKAGE_LIBARCHIVE=y
BR2_PACKAGE_LZO=y
BR2_PACKAGE_LIBGCRYPT=y
BR2_PACKAGE_LIBFUSE=y
BR2_PACKAGE_FONTCONFIG=y
BR2_PACKAGE_LIBART=y
BR2_PACKAGE_PIXMAN=y
BR2_PACKAGE_TIFF=y
BR2_PACKAGE_LIBUSB=y
BR2_PACKAGE_LIBUSB_COMPAT=y
BR2_PACKAGE_LIBXKBCOMMON=y
BR2_PACKAGE_MTDEV=y
BR2_PACKAGE_TSLIB=y
BR2_PACKAGE_YAJL=y
BR2_PACKAGE_LIBLOG4C_LOCALTIME=y
BR2_PACKAGE_LIBCURL=y
BR2_PACKAGE_LIBFCGI=y
BR2_PACKAGE_LIBOPING=y
BR2_PACKAGE_LIBPCAP=y
BR2_PACKAGE_APR_UTIL=y
BR2_PACKAGE_GTEST=y
BR2_PACKAGE_LIBCAP=y
BR2_PACKAGE_PROTOBUF_C=y
BR2_PACKAGE_LIBESMTP=y
BR2_PACKAGE_ARPTABLES=y
BR2_PACKAGE_ETHTOOL=y
BR2_PACKAGE_IPTABLES=y
BR2_PACKAGE_NETSNMP=y
BR2_PACKAGE_NTP=y
BR2_PACKAGE_NTP_NTPDATE=y
BR2_PACKAGE_NTP_NTPQ=y
BR2_PACKAGE_OPENSSH=y
BR2_PACKAGE_BASH=y
BR2_PACKAGE_FILE=y
BR2_PACKAGE_LOCKFILE_PROGS=y
BR2_PACKAGE_KMOD=y
BR2_PACKAGE_SYSKLOGD=y
BR2_TARGET_ROOTFS_JFFS2=y
BR2_TARGET_ROOTFS_JFFS2_DIR="var usr/share/hach usr/share/jail"
BR2_TARGET_ROOTFS_JFFS2_CUSTOM=y
BR2_TARGET_ROOTFS_JFFS2_CUSTOM_PAGESIZE=0x100
BR2_TARGET_ROOTFS_JFFS2_CUSTOM_EBSIZE=0x10000
BR2_TARGET_ROOTFS_JFFS2_SUMMARY=y
BR2_TARGET_ROOTFS_SQUASHFS=y
BR2_TARGET_ROOTFS_TAR_GZIP=y
BR2_TARGET_AT91BOOTSTRAP3=y
BR2_TARGET_AT91BOOTSTRAP3_CUSTOM_GIT=y
BR2_TARGET_AT91BOOTSTRAP3_CUSTOM_REPO_URL="git@github.com:linux4hach/at91bootstrap.git"
BR2_TARGET_AT91BOOTSTRAP3_CUSTOM_REPO_VERSION="at91bootstrap-3.x"
BR2_TARGET_AT91BOOTSTRAP3_DEFCONFIG="hach_at91sam9x5ekdf_uboot"
BR2_TARGET_UBOOT=y
BR2_TARGET_UBOOT_BOARDNAME="at91sam9x5ek_dataflash"
BR2_TARGET_UBOOT_CUSTOM_GIT=y
BR2_TARGET_UBOOT_CUSTOM_REPO_URL="https://github.com/linux4hach/u-boot-at91.git"
BR2_TARGET_UBOOT_CUSTOM_REPO_VERSION="u-boot-2014.07-at91"
BR2_TARGET_UBOOT_FORMAT_CUSTOM=y
BR2_TARGET_UBOOT_FORMAT_CUSTOM_NAME="uboot.bin"
BR2_PACKAGE_HOST_E2FSPROGS=y
BR2_PACKAGE_HOST_GENEXT2FS=y
BR2_PACKAGE_HOST_SAM_BA=y
```
